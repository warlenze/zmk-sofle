## config/west.yml
```yaml
manifest:
  remotes:
    - name: warlenze
      url-base: https://github.com/warlenze
    - name: mctechnology17
      url-base: https://github.com/mctechnology17
  projects:
    - name: zmk
      remote: warlenze
      revision: main
      import: app/west.yml
    - name: zmk-nice-oled
      remote: mctechnology17
      revision: main
  self:
    path: config
```
